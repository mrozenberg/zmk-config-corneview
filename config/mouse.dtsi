// ZMK_POINTING_DEFAULT_MOVE_VAL / SCRL_VAL are defined at the top of corne.keymap
// (they must precede the transitive include of pointing.h via behaviors.dtsi).

#include <input/processors.dtsi>
#include <zephyr/dt-bindings/input/input-event-codes.h>

// Based on @urob's config https://github.com/urob/zmk-config/blob/main/config/mouse.dtsi
&mmv_input_listener {
  warp {
    layers = <1>;
    input-processors = <&zip_xy_scaler 2 1>;
  };
  precision {
    layers = <2>;
    input-processors = <&zip_xy_scaler 1 2>;
  };
};

#define MM_U &mmv MOVE_UP
#define MM_D &mmv MOVE_DOWN
#define MM_L &mmv MOVE_LEFT
#define MM_R &mmv MOVE_RIGHT
#define SM_U &msc SCRL_UP
#define SM_D &msc SCRL_DOWN
#define SM_L &msc SCRL_LEFT
#define SM_R &msc SCRL_RIGHT